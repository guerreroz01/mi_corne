## boards/shields/eyelash_corne_dongle/Kconfig.shield
```kconfig
# No whitespace after the comma or in the keyboard name!
config SHIELD_EYELASH_CORNE_DONGLE
    def_bool $(shields_list_contains,eyelash_corne_dongle)
```
